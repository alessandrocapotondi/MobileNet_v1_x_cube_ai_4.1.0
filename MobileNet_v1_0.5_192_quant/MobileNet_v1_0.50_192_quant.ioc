# file: MobileNet_v1_0.50_192_quant.ioc
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CORTEX_M7.CPU_DCache=Enabled
CORTEX_M7.CPU_ICache=Enabled
Mcu.Family=STM32H7
Mcu.Name=STM32H743ZITx
Mcu.Package=LQFP144
NVIC.PriorityGroup=NVIC_PRIORITYGROUP_4
ProjectManager.HeapSize=0x0
ProjectManager.StackSize=0x400
ProjectManager.TargetToolchain=SW4STM32
RCC.ADCFreq_Value=129000000
RCC.APB1Freq_Value=120000000
RCC.APB2Freq_Value=120000000
RCC.APB3Freq_Value=120000000
RCC.APB4Freq_Value=120000000
RCC.CortexFreq_Value=480000000
RCC.D1PPRE=RCC_APB3_DIV2
RCC.D2PPRE1=RCC_APB1_DIV2
RCC.D2PPRE2=RCC_APB2_DIV2
RCC.D3PPRE=RCC_APB4_DIV2
RCC.DIVM1=4
RCC.DIVN1=60
RCC.HCLKFreq_Value=240000000
RCC.HPRE=RCC_HCLK_DIV2
RCC.PLL2FRACN=0
RCC.PLL3FRACN=0
RCC.PLLFRACN=0
RCC.SYSCLKFreq_VALUE=480000000
RCC.SYSCLKSource=RCC_SYSCLKSOURCE_PLLCLK
RCC.USBFreq_Value=480000000
STMicroelectronics.X-CUBE-AI.4.1.0.ActivationBufferSizeList=590432
STMicroelectronics.X-CUBE-AI.4.1.0.ArtificialOoIntelligenceJjXAaCUBEAaAI.cmp_version0=4.1.0
STMicroelectronics.X-CUBE-AI.4.1.0.ArtificialOoIntelligenceJjXAaCUBEAaAI.component0=Artificial Intelligence
STMicroelectronics.X-CUBE-AI.4.1.0.ArtificialOoIntelligenceJjXAaCUBEAaAI.componentDoc0=nofile
STMicroelectronics.X-CUBE-AI.4.1.0.ArtificialOoIntelligenceJjXAaCUBEAaAI.description0=AI Core,Artificial Intelligence for STM32
STMicroelectronics.X-CUBE-AI.4.1.0.ArtificialOoIntelligenceJjXAaCUBEAaAI.diagnostic0=This component should operate correctly.
STMicroelectronics.X-CUBE-AI.4.1.0.ArtificialOoIntelligenceJjXAaCUBEAaAI.documentation0=Documentation/index.html
STMicroelectronics.X-CUBE-AI.4.1.0.ArtificialOoIntelligenceJjXAaCUBEAaAI.group0=Core
STMicroelectronics.X-CUBE-AI.4.1.0.ArtificialOoIntelligenceJjXAaCUBEAaAI.paramName0=XAaCUBEAaAICcArtificialOoIntelligenceJjCore
STMicroelectronics.X-CUBE-AI.4.1.0.ArtificialOoIntelligenceJjXAaCUBEAaAI.sevirity0=none
STMicroelectronics.X-CUBE-AI.4.1.0.ArtificialOoIntelligenceJjXAaCUBEAaAI_bundle=X-CUBE-AI
STMicroelectronics.X-CUBE-AI.4.1.0.ArtificialOoIntelligenceJjXAaCUBEAaAI_class=ArtificialOoIntelligence
STMicroelectronics.X-CUBE-AI.4.1.0.ArtificialOoIntelligenceJjXAaCUBEAaAI_name=X-CUBE-AI
STMicroelectronics.X-CUBE-AI.4.1.0.ArtificialOoIntelligenceJjXAaCUBEAaAI_size=1
STMicroelectronics.X-CUBE-AI.4.1.0.ArtificialOoIntelligenceJjXAaCUBEAaAI_vendor=STMicroelectronics
STMicroelectronics.X-CUBE-AI.4.1.0.ArtificialOoIntelligenceJjXAaCUBEAaAI_version=4.1.0
STMicroelectronics.X-CUBE-AI.4.1.0.HeapSize=0x0
STMicroelectronics.X-CUBE-AI.4.1.0.InternalRamActivationBufferMaxSize=AI_CNN_DATA_ACTIVATIONS_SIZE
STMicroelectronics.X-CUBE-AI.4.1.0.LatestDirectoryUsed-34343cf3896c97db676e4c46ad9d2a48ad9b19a919e3d0230cbf0c8574e5cd16=C\:\\Users\\Alessandro Capotondi\\Desktop\\mobilenet_v1_0.5_192_quant
STMicroelectronics.X-CUBE-AI.4.1.0.ModelActualCompression-34343cf3896c97db676e4c46ad9d2a48ad9b19a919e3d0230cbf0c8574e5cd16=0.0
STMicroelectronics.X-CUBE-AI.4.1.0.ModelCompression-34343cf3896c97db676e4c46ad9d2a48ad9b19a919e3d0230cbf0c8574e5cd16=1
STMicroelectronics.X-CUBE-AI.4.1.0.ModelFlashOccupation-34343cf3896c97db676e4c46ad9d2a48ad9b19a919e3d0230cbf0c8574e5cd16=1346052
STMicroelectronics.X-CUBE-AI.4.1.0.ModelHashList=34343cf3896c97db676e4c46ad9d2a48ad9b19a919e3d0230cbf0c8574e5cd16
STMicroelectronics.X-CUBE-AI.4.1.0.ModelKind-34343cf3896c97db676e4c46ad9d2a48ad9b19a919e3d0230cbf0c8574e5cd16=TFLITE
STMicroelectronics.X-CUBE-AI.4.1.0.ModelMacc-34343cf3896c97db676e4c46ad9d2a48ad9b19a919e3d0230cbf0c8574e5cd16=110014868
STMicroelectronics.X-CUBE-AI.4.1.0.ModelName-34343cf3896c97db676e4c46ad9d2a48ad9b19a919e3d0230cbf0c8574e5cd16=cnn
STMicroelectronics.X-CUBE-AI.4.1.0.ModelNameList=cnn
STMicroelectronics.X-CUBE-AI.4.1.0.ModelRamOccupation-34343cf3896c97db676e4c46ad9d2a48ad9b19a919e3d0230cbf0c8574e5cd16=590432
STMicroelectronics.X-CUBE-AI.4.1.0.ModelStructureFile-34343cf3896c97db676e4c46ad9d2a48ad9b19a919e3d0230cbf0c8574e5cd16=C\:\\Users\\Alessandro Capotondi\\Desktop\\mobilenet_v1_0.5_192_quant\\mobilenet_v1_0.5_192_quant.tflite
STMicroelectronics.X-CUBE-AI.4.1.0.ModelType-34343cf3896c97db676e4c46ad9d2a48ad9b19a919e3d0230cbf0c8574e5cd16=Saved model
STMicroelectronics.X-CUBE-AI.4.1.0.StackSize=0x400
STMicroelectronics.X-CUBE-AI.4.1.0.WorkingBufferStartAddrList=0xFFFFFFFF
STMicroelectronics.X-CUBE-AI.4.1.0.XAaCUBEAaAICcArtificialOoIntelligenceJjCore=true
STMicroelectronics.X-CUBE-AI.4.1.0.copyWeightToRam-34343cf3896c97db676e4c46ad9d2a48ad9b19a919e3d0230cbf0c8574e5cd16=false
STMicroelectronics.X-CUBE-AI.4.1.0_ArtificialOoIntelligenceJjApplication_RteComponentsize=0
STMicroelectronics.X-CUBE-AI.4.1.0_ArtificialOoIntelligenceJjXAaCUBEAaAI_RteComponentsize=0
STMicroelectronics.X-CUBE-AI.4.1.0_MwName0=X-CUBE-AI
STMicroelectronics.X-CUBE-AI.4.1.0_NumberOfMw=1
STMicroelectronics.X-CUBE-AI.4.1.0_description=Artificial Intelligence
STMicroelectronics.X-CUBE-AI.4.1.0_license=SLA0048.txt
VP_CRC_VS_CRC.Mode=CRC_Activate
VP_STMicroelectronics.X-CUBE-AI_VS_ArtificialOoIntelligenceJjApplication_4.1.0.Mode=ArtificialOoIntelligenceJjApplication
VP_STMicroelectronics.X-CUBE-AI_VS_ArtificialOoIntelligenceJjXAaCUBEAaAI_4.1.0.Mode=ArtificialOoIntelligenceJjXAaCUBEAaAI
board=custom

// file: Src/main.c
/* USER CODE BEGIN Header */
/**
  ******************************************************************************
  * @file           : main.c
  * @brief          : Main program body
  ******************************************************************************
  * @attention
  *
  * <h2><center>&copy; Copyright (c) 2019 STMicroelectronics.
  * All rights reserved.</center></h2>
  *
  * This software component is licensed by ST under Ultimate Liberty license
  * SLA0044, the "License"; You may not use this file except in compliance with
  * the License. You may obtain a copy of the License at:
  *                             www.st.com/SLA0044
  *
  ******************************************************************************
  */
/* USER CODE END Header */

#include "main.h"
#include "app_x-cube-ai.h"

/* USER CODE BEGIN Includes */
#include <stdlib.h>
#include <stdio.h>
/* USER CODE END Includes */

CRC_HandleTypeDef hcrc;

void SystemClock_Config(void);
static void MX_CRC_Init(void);

int main(void)
{

  /* Enable I-Cache---------------------------------------------------------*/
  SCB_EnableICache();

  /* Enable D-Cache---------------------------------------------------------*/
  SCB_EnableDCache();

  /* MCU Configuration--------------------------------------------------------*/

  /* Reset of all peripherals, Initializes the Flash interface and the Systick. */
  HAL_Init();

  /* Configure the system clock */
  SystemClock_Config();

  /* Initialize all configured peripherals */
  MX_CRC_Init();
  MX_X_CUBE_AI_Init();

  /* Infinite loop */
  /* USER CODE BEGIN WHILE */

  USR_CC_ENABLE();
  USR_CC_RESET();
  usr_nr_nb_run=1;

  /* fill a float array with random data in the range [-1, 1] */
  for ( ai_size i=0; i<AI_CNN_IN_1_SIZE; i++ ) {
      const ai_float r = (((ai_float)rand()/RAND_MAX)*2)-1;
      in_data[i] = r;
  }

  while (1)
  {
	  USR_CC_RESET();
    /* USER CODE END WHILE */

  MX_X_CUBE_AI_Process();
    /* USER CODE BEGIN 3 */
	  USR_GET_CC_TIMESTAMP(usr_cycle_counter);
	  USR_GET_CC_ACC_TIMESTAMP(usr_cycle_counter_acc);

	  /* Avg Cycles */
	  usr_cycle_counter_avg = usr_cycle_counter_acc / usr_nr_nb_run;
	  usr_nr_nb_run++;
  }
  /* USER CODE END 3 */
}

void SystemClock_Config(void)
{
  RCC_OscInitTypeDef RCC_OscInitStruct = {0};
  RCC_ClkInitTypeDef RCC_ClkInitStruct = {0};

  /** Supply configuration update enable
  */
  HAL_PWREx_ConfigSupply(PWR_LDO_SUPPLY);
  /** Configure the main internal regulator output voltage
  */
  __HAL_PWR_VOLTAGESCALING_CONFIG(PWR_REGULATOR_VOLTAGE_SCALE0);

  while(!__HAL_PWR_GET_FLAG(PWR_FLAG_VOSRDY)) {}
  /** Initializes the CPU, AHB and APB busses clocks
  */
  RCC_OscInitStruct.OscillatorType = RCC_OSCILLATORTYPE_HSI;
  RCC_OscInitStruct.HSIState = RCC_HSI_DIV1;
  RCC_OscInitStruct.HSICalibrationValue = RCC_HSICALIBRATION_DEFAULT;
  RCC_OscInitStruct.PLL.PLLState = RCC_PLL_ON;
  RCC_OscInitStruct.PLL.PLLSource = RCC_PLLSOURCE_HSI;
  RCC_OscInitStruct.PLL.PLLM = 4;
  RCC_OscInitStruct.PLL.PLLN = 60;
  RCC_OscInitStruct.PLL.PLLP = 2;
  RCC_OscInitStruct.PLL.PLLQ = 2;
  RCC_OscInitStruct.PLL.PLLR = 2;
  RCC_OscInitStruct.PLL.PLLRGE = RCC_PLL1VCIRANGE_3;
  RCC_OscInitStruct.PLL.PLLVCOSEL = RCC_PLL1VCOWIDE;
  RCC_OscInitStruct.PLL.PLLFRACN = 0;
  if (HAL_RCC_OscConfig(&RCC_OscInitStruct) != HAL_OK)
  {
    Error_Handler();
  }
  /** Initializes the CPU, AHB and APB busses clocks
  */
  RCC_ClkInitStruct.ClockType = RCC_CLOCKTYPE_HCLK|RCC_CLOCKTYPE_SYSCLK
                              |RCC_CLOCKTYPE_PCLK1|RCC_CLOCKTYPE_PCLK2
                              |RCC_CLOCKTYPE_D3PCLK1|RCC_CLOCKTYPE_D1PCLK1;
  RCC_ClkInitStruct.SYSCLKSource = RCC_SYSCLKSOURCE_PLLCLK;
  RCC_ClkInitStruct.SYSCLKDivider = RCC_SYSCLK_DIV1;
  RCC_ClkInitStruct.AHBCLKDivider = RCC_HCLK_DIV2;
  RCC_ClkInitStruct.APB3CLKDivider = RCC_APB3_DIV2;
  RCC_ClkInitStruct.APB1CLKDivider = RCC_APB1_DIV2;
  RCC_ClkInitStruct.APB2CLKDivider = RCC_APB2_DIV2;
  RCC_ClkInitStruct.APB4CLKDivider = RCC_APB4_DIV2;

  if (HAL_RCC_ClockConfig(&RCC_ClkInitStruct, FLASH_LATENCY_4) != HAL_OK)
  {
    Error_Handler();
  }
}

static void MX_CRC_Init(void)
{

  hcrc.Instance = CRC;
  hcrc.Init.DefaultPolynomialUse = DEFAULT_POLYNOMIAL_ENABLE;
  hcrc.Init.DefaultInitValueUse = DEFAULT_INIT_VALUE_ENABLE;
  hcrc.Init.InputDataInversionMode = CRC_INPUTDATA_INVERSION_NONE;
  hcrc.Init.OutputDataInversionMode = CRC_OUTPUTDATA_INVERSION_DISABLE;
  hcrc.InputDataFormat = CRC_INPUTDATA_FORMAT_BYTES;
  if (HAL_CRC_Init(&hcrc) != HAL_OK)
  {
    Error_Handler();
  }

}

void Error_Handler(void)
{
}

/************************ (C) COPYRIGHT STMicroelectronics *****END OF FILE****/
